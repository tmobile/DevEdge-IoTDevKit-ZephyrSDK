## boards/arm/tmo_dev_edge/tmo_dev_edge_defconfig
```kconfig
#
# Copyright (c) 2022 T-Mobile USA, Inc.
#
# SPDX-License-Identifier: Apache-2.0
#

CONFIG_ARM_MPU=y
CONFIG_SOC_SERIES_EFM32PG12B=y
CONFIG_BOARD_TMO_DEV_EDGE=y
CONFIG_CONSOLE=y
CONFIG_UART_CONSOLE=y
CONFIG_SERIAL=y
CONFIG_CORTEX_M_SYSTICK=y
CONFIG_SYS_CLOCK_HW_CYCLES_PER_SEC=38400000
CONFIG_GPIO=y
CONFIG_SHELL=y
CONFIG_GPIO_SHELL=y
CONFIG_POSIX_CLOCK=y
CONFIG_DEVICE_SHELL=y
CONFIG_CMU_HFCLK_HFXO=y
CONFIG_HW_STACK_PROTECTION=y
CONFIG_CMU_HFCLK_HFRCO=y
CONFIG_I2C=y
CONFIG_SPI=y
CONFIG_REBOOT=y
CONFIG_COUNTER=y
CONFIG_NOTIFY=y
CONFIG_PINCTRL=y
CONFIG_LED=y
CONFIG_LED_PWM=y
CONFIG_LED_SHELL=y
CONFIG_PWM=y
CONFIG_PWM_SHELL=y
CONFIG_PWM_GECKO=y
CONFIG_TIME_GECKO_RTCC=y
CONFIG_USE_SEGGER_RTT=y
```

## dfu_gecko/Kconfig.dfu_gecko
```kconfig
# DFU Gecko updagte configuration options

# Copyright (c) 2021 Kim Mansfield <kmansfie@yahoo.com>
# Copyright (c) 2022 T-Mobile USA, Inc.
# SPDX-Licnse-Identifiere: Apache-2.0
#

config SHELL_DFU_GECKO_UPDATE
        bool "DFU Gecko Update Library"
	help
           Enable DFU Gecko update library inclusion
```

## libs/dfu_gecko/Kconfig.dfu_gecko
```kconfig
# DFU Gecko updagte configuration options

# Copyright (c) 2021 Kim Mansfield <kmansfie@yahoo.com>
# Copyright (c) 2022 T-Mobile USA, Inc.
# SPDX-Licnse-Identifiere: Apache-2.0
#

config DFU_GECKO_LIB
        bool "DFU Gecko Update Library"
	help
           Enable DFU Gecko update library inclusion
```
