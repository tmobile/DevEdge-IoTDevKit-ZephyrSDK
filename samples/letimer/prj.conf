## CMakeLists.txt
```
# SPDX-License-Identifier: Apache-2.0

cmake_minimum_required(VERSION 3.20.0)

find_package(Zephyr REQUIRED HINTS $ENV{ZEPHYR_BASE})
project(gecko_letimer_test)

target_sources(app PRIVATE src/main.c)
```

## prj.conf
```kconfig
CONFIG_PM=y
CONFIG_CORTEX_M_SYSTICK=n
CONFIG_GECKO_LETIMER=y
CONFIG_GECKO_LETIMER_USE_REP=y
CONFIG_SYS_CLOCK_TICKS_PER_SEC=8192
```

## src/main.c
```c
/*
 * Copyright (c) 2023 T-Mobile USA, Inc.
 *
 * SPDX-License-Identifier: Apache-2.0
 */

#include <zephyr/kernel.h>
#include <zephyr/pm/pm.h>

void main(void)
{
	printk("Test start\n");
	pm_state_force(0u, &(struct pm_state_info){PM_STATE_SUSPEND_TO_IDLE, 0, 0});
	k_msleep(1000);
	printk("1 second\n");
	pm_state_force(0u, &(struct pm_state_info){PM_STATE_SUSPEND_TO_IDLE, 0, 0});
	k_msleep(1000);
	printk("1 second (2)\n");
	pm_state_force(0u, &(struct pm_state_info){PM_STATE_SUSPEND_TO_IDLE, 0, 0});
	k_msleep(1000);
	printk("1 second (3)\n");
	pm_state_force(0u, &(struct pm_state_info){PM_STATE_SUSPEND_TO_IDLE, 0, 0});
	k_msleep(1000);
	printk("1 second (4)\n");
	pm_state_force(0u, &(struct pm_state_info){PM_STATE_SUSPEND_TO_IDLE, 0, 0});
	k_msleep(1000);
	printk("1 second (5)\n");
	pm_state_force(0u, &(struct pm_state_info){PM_STATE_SUSPEND_TO_IDLE, 0, 0});
	k_msleep(60000);
	printk("60 second\n");
}
```
