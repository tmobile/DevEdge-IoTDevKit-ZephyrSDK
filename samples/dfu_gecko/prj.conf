## CMakeLists.txt
```
# SPDX-License-Identifier: Apache-2.0

cmake_minimum_required(VERSION 3.13.1)

find_package(Zephyr REQUIRED HINTS $ENV{ZEPHYR_BASE})
project(hello_world)

target_sources(app PRIVATE src/main.c)

target_include_directories(app PUBLIC ${CMAKE_CURRENT_SOURCE_DIR}/lib)
add_subdirectory(lib)
target_link_libraries(app PUBLIC dfu_gecko)
```

## prj.conf
```kconfig
# Copyright (c) 2022 T-Mobile USA, Inc.
#
# SPDX-License-Identifier: Apache-2.0

# UART support
CONFIG_SERIAL=y
CONFIG_SHELL_BACKEND_SERIAL_RX_RING_BUFFER_SIZE=1024

CONFIG_RING_BUFFER=y
CONFIG_SOC_FLASH_GECKO=y

CONFIG_ADC=y
CONFIG_ADC_SHELL=n
# Enable support for the flash hardware.
CONFIG_FLASH=y
CONFIG_I2C=y

CONFIG_SPI=y
CONFIG_SPI_NOR=y
CONFIG_SPI_GECKO=y

# Murata 1SC modem support
CONFIG_MODEM=y
CONFIG_MODEM_SHELL=y
CONFIG_MODEM_MURATA_1SC=y
CONFIG_MODEM_MURATA_1SC_APN="CATM.T-MOBILE.COM"

# Generic networking options
CONFIG_NETWORKING=y
CONFIG_NET_SHELL=n
CONFIG_NET_NATIVE=n
CONFIG_NET_OFFLOAD=y
CONFIG_NET_IPV6_DAD=n
CONFIG_NET_UDP=y
CONFIG_NET_TCP=y
CONFIG_NET_IPV6=n
CONFIG_NET_IPV4=y
CONFIG_DNS_RESOLVER=n
CONFIG_POSIX_MAX_FDS=15
CONFIG_HTTP_CLIENT=y

# Network management events
CONFIG_NET_CONNECTION_MANAGER=y
CONFIG_NET_MGMT=y
CONFIG_NET_MGMT_EVENT=y

# Debugging
# CONFIG_DEBUG_OPTIMIZATIONS=y

# Logging
CONFIG_LOG=y
CONFIG_NET_LOG=y

CONFIG_CONSOLE_SUBSYS=y
CONFIG_CONSOLE_GETLINE=y

# Network buffers
CONFIG_NET_PKT_RX_COUNT=1
CONFIG_NET_PKT_TX_COUNT=1
CONFIG_NET_BUF_RX_COUNT=1
CONFIG_NET_BUF_TX_COUNT=1
CONFIG_NET_CONTEXT_NET_PKT_POOL=y
CONFIG_NET_BUF_DATA_SIZE=60

# RS9116
CONFIG_WIFI=y
CONFIG_WIFI_RS9116W=y
CONFIG_GPIO=y

#CONFIG_TEST_RANDOM_GENERATOR=y

CONFIG_INIT_STACKS=y

CONFIG_MBEDTLS_DTLS=y

CONFIG_NET_SOCKETS=y
CONFIG_NET_SOCKETS_OFFLOAD=y
CONFIG_NET_SOCKETS_POSIX_NAMES=y
CONFIG_NET_SOCKETS_POLL_MAX=4
CONFIG_NET_SOCKETS_SOCKOPT_TLS=y
CONFIG_NET_SOCKETS_TLS_MAX_CONTEXTS=4
CONFIG_NET_SOCKETS_ENABLE_DTLS=y


# Bluetooth / BLE
CONFIG_BT=y
CONFIG_BT_CUSTOM=y
CONFIG_BT_RS9116W=y
CONFIG_BT_PERIPHERAL=y
CONFIG_BT_SMP=y
CONFIG_BT_MAX_PAIRED=2
CONFIG_BT_DEBUG=n

# Sensors
CONFIG_SENSOR=y
CONFIG_SENSOR_SHELL=y

# Stack sizes
CONFIG_MAIN_STACK_SIZE=4096
CONFIG_SHELL_STACK_SIZE=4096

# MBED TLS configuration
CONFIG_MBEDTLS=y
CONFIG_MBEDTLS_BUILTIN=y

# CONFIG_NEWLIB_LIBC=y
CONFIG_MINIMAL_LIBC_MALLOC=y
CONFIG_MINIMAL_LIBC_MALLOC_ARENA_SIZE=2048

# Set number IPv4 network interfaces
CONFIG_NET_IF_MAX_IPV4_COUNT=2
# CONFIG_NET_IF_MAX_IPV6_COUNT=2

#CONFIG_FS_LOG_LEVEL_DBG=y

CONFIG_HEAP_MEM_POOL_SIZE=16384

CONFIG_SHELL=y
CONFIG_SHELL_LOG_LEVEL_INF=y
CONFIG_SHELL_CMD_BUFF_SIZE=2100

CONFIG_FILE_SYSTEM=y
CONFIG_FILE_SYSTEM_SHELL=y
CONFIG_FILE_SYSTEM_LITTLEFS=y

CONFIG_FLASH_MAP=y
CONFIG_FLASH_PAGE_LAYOUT=y

CONFIG_RS9116W_TLS_OFFLOAD=y

#CONFIG_TMO_SHELL_SSID=""
#CONFIG_TMO_SHELL_PSK=""

CONFIG_RS9116_DNS_SERVER_IP_ADDRESSES=y
CONFIG_RS9116_IPV4_DNS_SERVER1="8.8.8.8"
CONFIG_RS9116_IPV6_DNS_SERVER1="2001:4860:4860::8888"

CONFIG_MODEM_MURATA_1SC_SOCKET_COUNT=4
CONFIG_WISECONNECT_SOCKETS_COUNT=6

CONFIG_SHELL_GETOPT=y
CONFIG_PING=y

CONFIG_MODEM_SMS_IN_MSG_MAX_LEN=200
CONFIG_MODEM_SMS_OUT_MSG_MAX_LEN=200

#Ekermit
CONFIG_SEGGER_RTT_MODE_BLOCK_IF_FIFO_FULL=y
CONFIG_LOG_BACKEND_RTT=n
#CONFIG_TMO_SHELL_BUILD_EK=y

#Power Managment
CONFIG_PM=y
CONFIG_PM_DEVICE=y

CONFIG_BT_DEVICE_NAME_DYNAMIC=y
CONFIG_LOG_PRINTK=n
```

## src/main.c
```c
#include <zephyr/kernel.h>
#include <dfu_gecko_lib.h>




void main(void)

{

}
```
