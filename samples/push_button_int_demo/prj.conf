## CMakeLists.txt
```
# Copyright (c) 2022 T-Mobile USA, Inc.
#
# SPDX-License-Identifier: Apache-2.0

cmake_minimum_required(VERSION 3.20.0)

find_package(Zephyr REQUIRED HINTS $ENV{ZEPHYR_BASE})
project(tmo_shell)

target_include_directories(app PRIVATE ${ZEPHYR_BASE}/subsys/ )
FILE(GLOB app_sources src/*.c)
target_sources(app PRIVATE src/main.c)

set(gen_dir ${ZEPHYR_BINARY_DIR}/include/generated/)

add_compile_definitions(VERSION_BOARD="${BOARD}")
```

## Kconfig
```
# Copyright (c) 2022 T-Mobile USA, Inc.
#
# SPDX-License-Identifier: Apache-2.0

mainmenu "tmo_shell application settings"

config TMO_SHELL_SSID
    string "SSID of WiFi network to automatically connect to"
    default ""
 
config TMO_SHELL_PSK
    string "PSK of WiFi network to automatically connect to"
    default ""

config TMO_SHELL_USE_MBED
    bool "Configure HTTP to use mbedTLS for TLS connections"
    default n

config TMO_SHELL_BUILD_EK
    bool "Build in ekermit"
    select USE_SEGGER_RTT
    default n

config TMO_HTTP_MOCK_SOCKET
    bool "Use mock socket for HTTP unit testing"
    default n

config SEGGER_RTT_BUFFER_SIZE_DOWN
    int
    default 8192 if TMO_SHELL_BUILD_EK

source "Kconfig.zephyr"
```

## prj.conf
```kconfig
# Copyright (c) 2022 T-Mobile USA, Inc.
#
# SPDX-License-Identifier: Apache-2.0

CONFIG_PM=y
# Required to disable default behavior of deep sleep on timeout
CONFIG_PM_DEVICE=y
CONFIG_GPIO=y
# Optional select RAM retention (nRF52 only)
#CONFIG_APP_RETENTION=y

# UART support
CONFIG_SERIAL=y
CONFIG_SHELL_BACKEND_SERIAL_RX_RING_BUFFER_SIZE=1024

CONFIG_RING_BUFFER=y
CONFIG_SOC_FLASH_GECKO=y

CONFIG_ADC=y
CONFIG_ADC_SHELL=n
# Enable support for the flash hardware.
CONFIG_FLASH=y
CONFIG_I2C=y

CONFIG_SPI=y
CONFIG_SPI_NOR=y
CONFIG_SPI_GECKO=y

# Logging
CONFIG_LOG=y
CONFIG_NET_LOG=y

CONFIG_CONSOLE_SUBSYS=y
CONFIG_CONSOLE_GETLINE=y

CONFIG_INIT_STACKS=y

# Sensors
CONFIG_SENSOR=y
CONFIG_SENSOR_SHELL=y

# Stack sizes
CONFIG_MAIN_STACK_SIZE=4096
CONFIG_SHELL_STACK_SIZE=4096

# CONFIG_NEWLIB_LIBC=y
CONFIG_MINIMAL_LIBC_MALLOC=y
CONFIG_MINIMAL_LIBC_MALLOC_ARENA_SIZE=2048

CONFIG_HEAP_MEM_POOL_SIZE=16384

CONFIG_SHELL=y
CONFIG_SHELL_LOG_LEVEL_INF=y
CONFIG_SHELL_CMD_BUFF_SIZE=2100
```

## overlay-bl.conf
```kconfig
# Copyright (c) 2022 T-Mobile USA, Inc.
#
# SPDX-License-Identifier: Apache-2.0

# mcuboot will relocate the interrupt vector to the booted application
CONFIG_BOOT_INTR_VEC_RELOC=y

# Chain-loadable image will be linked into its code partition, specified in DeviceTree.
CONFIG_USE_DT_CODE_PARTITION=y

# Force the initialization of the internal Cortex-M architectural state during boot
# to the reset values as specified by the corresponding Arm architecture manual.
CONFIG_INIT_ARCH_HW_AT_BOOT=y

# chain-loadable images relocate the Cortex-M vector table by updating the
# VTOR register with the offset of the image vector table.
#CONFIG_CPU_CORTEX_M_HAS_VTOR=y

# Relay exceptions and interrupts based on a vector table pointer that is set by the chain-loadable application.
CONFIG_SW_VECTOR_RELAY=y

# Instruct the boot sequence to set the vector table pointer in SRAM so that the bootloader can forward
# the exceptions and interrupts to the chain-loadable image’s software vector table.
CONFIG_SW_VECTOR_RELAY_CLIENT=y

# Zephyr will relocate .text, data and .bss sections from the specified files and
# place it in SRAM.
CONFIG_BOOT_DIRECT_XIP=y
CONFIG_BOOTLOADER_MCUBOOT=y
```

## overlay-mbed.conf
```kconfig
# Copyright (c) 2022 T-Mobile USA, Inc.
#
# SPDX-License-Identifier: Apache-2.0

CONFIG_MBEDTLS_HEAP_SIZE=30000
CONFIG_MBEDTLS_SSL_MAX_CONTENT_LEN=7168
CONFIG_MBEDTLS_SERVER_NAME_INDICATION=y
CONFIG_MBEDTLS_ENABLE_HEAP=y
CONFIG_CTR_DRBG_CSPRNG_GENERATOR=y

CONFIG_NET_SOCKETS_OFFLOAD_DISPATCHER=y

CONFIG_TMO_SHELL_USE_MBED=y
```

## boards/tmo_dev_edge.conf
```kconfig
# Copyright (c) 2022 T-Mobile USA, Inc.
#
# SPDX-License-Identifier: Apache-2.0

CONFIG_BT_DEVICE_NAME="TMO DevEdge"
CONFIG_POSIX_CLOCK=y
CONFIG_CMU_HFCLK_HFXO=y
CONFIG_DEVICE_SHELL=y
CONFIG_GPIO_SHELL=y
CONFIG_SOC_GECKO_EMU_DCDC=y
CONFIG_SOC_GECKO_EMU_DCDC_MODE_OFF=y
CONFIG_I2C=y
CONFIG_SPI=y
CONFIG_REBOOT=y
CONFIG_COUNTER=y
CONFIG_LED=y
CONFIG_LED_PWM=y
CONFIG_LED_SHELL=y
CONFIG_PWM=y
CONFIG_PWM_SHELL=y
CONFIG_PWM_GECKO=y
CONFIG_SENSOR=y
CONFIG_SENSOR_SHELL=y
CONFIG_LPS22HH=y
CONFIG_LIS2DW12=y
CONFIG_TSL2540=y
CONFIG_TMP108=y
CONFIG_CXD5605=y
```

## src/main.c
```c
/*
 * Copyright (c) 2022 T-Mobile USA, Inc.
 *
 * SPDX-License-Identifier: Apache-2.0
 */
#include <stdio.h>
#include <zephyr/zephyr.h>
#include <zephyr/device.h>
#include <zephyr/init.h>
#include <zephyr/pm/pm.h>
#include <zephyr/pm/device.h>
#include <zephyr/pm/policy.h>
#include <soc.h>
#include <drivers/gpio.h>

#define GECKO_CONSOLE DT_LABEL(DT_CHOSEN(zephyr_console))
#define BUSY_WAIT_DURATION 2U
#define SLEEP_DURATION 2U

#define PUSH_BUTTON_GPIO_B_NAME  "GPIO_B"
#define PUSH_BUTTON_INT1              13   /* PB13 - configured here */

static const struct device *gpiob_dev;

/* User Push Button (sw0) interrupt callback */
static struct gpio_callback gpio_cb;
int  push_button_isr_count = 0;
bool push_button_isr_state_change = false;

void user_push_button_intr_callback(const struct device *port,
                struct gpio_callback *cb, uint32_t pins)
{
        push_button_isr_count++;
        push_button_isr_state_change = true;
        printf("\nPush Button (sw0) Interrupt detected\n");
}

/* Prevent the deep sleep (non-recoverable shipping mode) from being entered on long timeouts
 * or `K_FOREVER` due to the default residency policy.
 *
 * This has to be done before anything tries to sleep, which means
 * before the threading system starts up between PRE_KERNEL_2 and
 * POST_KERNEL.  Do it at the start of PRE_KERNEL_2.
 */

static int disable_deep_sleep(const struct device *dev)
{
	ARG_UNUSED(dev);

	pm_policy_state_lock_get(PM_STATE_SOFT_OFF, PM_ALL_SUBSTATES);
	return 0;
}

SYS_INIT(disable_deep_sleep, PRE_KERNEL_2, 0);

void main(void)
{
	int ret;

	/* Wait for zephyr kernel init to complete */
	k_msleep(2000);

	const struct device *console = device_get_binding(GECKO_CONSOLE);
	printk("\nThis Sample Demo App implements a Gecko Sleep-Wake Up on Push Button Interrupt using %s\n", CONFIG_BOARD);

	gpiob_dev = device_get_binding(PUSH_BUTTON_GPIO_B_NAME);
        if (!gpiob_dev) {
                printf("GPIOB driver error\n");
        }

        ret = gpio_pin_configure(gpiob_dev,
                                 PUSH_BUTTON_INT1,
                                 GPIO_INPUT | GPIO_PULL_UP | GPIO_INT_EDGE_BOTH);
        if (ret) {
                printf("Error configuring GPIO_B %d!\n", PUSH_BUTTON_INT1);
        }

        gpio_init_callback(&gpio_cb, user_push_button_intr_callback, BIT(PUSH_BUTTON_INT1));

        ret = gpio_add_callback(gpiob_dev, &gpio_cb);
        if (ret) {
                printf("Cannot setup callback!\n");
        }

        ret = gpio_pin_interrupt_configure(gpiob_dev,
                                           PUSH_BUTTON_INT1,
                                           GPIO_INPUT | GPIO_PULL_UP | GPIO_INT_EDGE_BOTH);

        k_msleep(1000);

	printk("Test of the User Button (sw0) interrupt - press The User Push Button (sw0) to continue \n");
	while(push_button_isr_count == 0)
	{
                k_msleep(1000);
	}
	printk("\nThe User Button (sw0) interrupt passed (%d) - continue\n", push_button_isr_count);

	k_msleep(2000);

	/* Force the current thread to busy wait. */
        /* This routine causes the current thread to execute a "do nothing" loop for usec_to_wait microseconds. */
	printk("\nTest of Busy-wait %u seconds\n", BUSY_WAIT_DURATION);
	k_busy_wait(BUSY_WAIT_DURATION * USEC_PER_SEC);

	printk("\nTest of thread Busy-wait %u seconds with UART off\n", BUSY_WAIT_DURATION);
	ret = pm_device_action_run(console, PM_DEVICE_ACTION_SUSPEND);
	k_busy_wait(BUSY_WAIT_DURATION * USEC_PER_SEC);
	ret = pm_device_action_run(console, PM_DEVICE_ACTION_RESUME);

	/* Put the current thread to sleep. */
        /* This routine puts the current thread to sleep for duration, specified as a k_timeout_t object. */
	printk("\nSleep %u seconds\n", SLEEP_DURATION);
	k_sleep(K_SECONDS(SLEEP_DURATION));

	printk("\nSleep %u seconds with UART off\n", SLEEP_DURATION);
	ret = pm_device_action_run(console, PM_DEVICE_ACTION_SUSPEND);
	k_sleep(K_SECONDS(SLEEP_DURATION));
	ret = pm_device_action_run(console, PM_DEVICE_ACTION_RESUME);

	printk("\nTesting Gecko EM mode Sleep Wakeup - press the user button to wake up \n");

	/* Try EM2 mode sleep */
	pm_state_force(0u, &(struct pm_state_info){ PM_STATE_SUSPEND_TO_IDLE, 0, 0});

	/* Try EM3 mode sleep */
        // pm_state_force(0u, &(struct pm_state_info){ PM_STATE_STANDBY, 0, 0});
	/* Try Deep sleep - shipping mode */
	// pm_state_force(0u, &(struct pm_state_info){PM_STATE_SOFT_OFF, 0, 0});

	/*
	 * This will let the idle thread run and let the pm subsystem run in forced state. 
	 */
	k_sleep(K_SECONDS(SLEEP_DURATION));

	printk("ERROR: The forced Sleep setting failed\n");
	while (true) {
		/* spin to avoid fall-off behavior */
	}
}
```
